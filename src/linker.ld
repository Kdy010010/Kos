/* linker.ld - 간단한 커널 링크 스크립트 예제
 * 이 스크립트는 부트로더가 커널을 0x8000 주소에 로드하는 환경에 맞춰 작성되었습니다.
 */

ENTRY(kmain)

SECTIONS
{
    /* 커널 시작 주소: 부트로더가 커널을 0x8000에 로드하므로 */
    . = 0x8000;

    /* 코드와 읽기 전용 데이터 */
    .text :
    {
        *(.text*)
    }

    /* 읽기 전용 데이터 (문자열 등) */
    .rodata :
    {
        *(.rodata*)
    }

    /* 초기화된 데이터 */
    .data :
    {
        *(.data*)
    }

    /* 초기화되지 않은 데이터 */
    .bss :
    {
        *(.bss*)
        *(COMMON)
    }
}
